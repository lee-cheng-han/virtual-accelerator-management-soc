## firmware/boards/vams_riscv/Kconfig.defconfig
```kconfig
# SPDX-License-Identifier: MIT

if BOARD_VAMS_RISCV

config BUILD_OUTPUT_BIN
	default y

config XIP
	default n

endif # BOARD_VAMS_RISCV
```

## firmware/boards/vams_riscv/board.yml
```yaml
board:
  name: vams_riscv
  full_name: VAMS RISC-V Management Subsystem
  vendor: vams
  socs:
    - name: vams_riscv
```

## firmware/boards/vams_riscv/vams_riscv_defconfig
```kconfig
# SPDX-License-Identifier: MIT

CONFIG_CONSOLE=y
CONFIG_SERIAL=y
CONFIG_UART_CONSOLE=y
CONFIG_STACK_SENTINEL=y
CONFIG_XIP=n
```

## firmware/soc/vams_riscv/Kconfig
```kconfig
# SPDX-License-Identifier: MIT

config SOC_VAMS_RISCV
	select INCLUDE_RESET_VECTOR
	select RISCV
	select RISCV_PRIVILEGED
	select RISCV_SOC_HAS_GP_RELATIVE_ADDRESSING
```

## firmware/soc/vams_riscv/Kconfig.defconfig
```kconfig
# SPDX-License-Identifier: MIT

if SOC_VAMS_RISCV

config SYS_CLOCK_HW_CYCLES_PER_SEC
	default 10000000

config NUM_IRQS
	default 16

config RISCV_SOC_INTERRUPT_INIT
	default y

endif # SOC_VAMS_RISCV
```

## firmware/soc/vams_riscv/Kconfig.soc
```kconfig
# SPDX-License-Identifier: MIT

config SOC_VAMS_RISCV
	bool

config SOC
	default "vams_riscv" if SOC_VAMS_RISCV
```

## kernel/Kconfig
```kconfig
# SPDX-License-Identifier: GPL-2.0-only
config VAMS_PCI
	tristate "Virtual Accelerator Management Subsystem PCIe support"
	depends on PCI && PCI_MSI
	help
	  Build the thin host queue and interrupt driver for the VAMS QEMU PCIe
	  endpoint. The driver validates BAR0 and ABI versions, negotiates a DMA
	  mask, owns coherent queues, tracks NOP requests, provides interrupt and
	  polling completion, and registers a versioned misc character device.

config VAMS_PCI_TESTING
	bool "VAMS PCI probe fault-injection controls"
	depends on VAMS_PCI
	help
	  Add module parameters that inject failures after each probe resource
	  acquisition and exercise MSI-X, NOP, and polling paths. This is intended
	  only for disposable test guests. Production builds omit the parameters
	  and their interrupt-forcing behavior. Enable this only in an isolated
	  QEMU guest used by the integration test.
```
